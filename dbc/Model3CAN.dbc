VERSION ""

NS_ :

BS_:

BU_: DIR DI SCCM

BO_ 264 DIR_torque: 8 DIR
 SG_ DIR_axleSpeed : 40|16@1- (0.1,0) [-2750|2750] "RPM" DIR
 SG_ DIR_torqueActual : 27|13@1- (2,0) [-7500|7500] "Nm" DIR

BO_ 280 DI_state: 8 DI
 SG_ DI_accelPedalPos : 32|8@1+ (0.4,0) [0|100] "%" DI
 SG_ DI_brakePedalState : 19|2@1+ (1,0) [0|2] "" DI

BO_ 297 SCCM_steeringAngle: 5 SCCM
 SG_ SteeringAngle129 : 16|14@1+ (0.1,-819.2) [-819.2|819.1] "deg" SCCM

VAL_ 280 DI_brakePedalState 0 "released" 1 "pressed" ;
